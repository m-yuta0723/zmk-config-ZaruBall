## boards/shields/ZaruBall/Kconfig.defconfig
```kconfig
if SHIELD_ZARUBALL_DONGLE

# Name must be less than 16 characters long!
config ZMK_KEYBOARD_NAME
    default "ZaruBall"

config ZMK_SPLIT_ROLE_CENTRAL
    default y

config ZMK_SPLIT
    default y

endif

if SHIELD_ZARUBALL_LEFT || SHIELD_ZARUBALL_RIGHT

config ZMK_SPLIT
    default y

config ZMK_SPLIT_BLE_CENTRAL_PERIPHERALS
    default 2

endif

# Input Device(pmw3610)のためのコンフィグ
if SHIELD_ZARUBALL_RIGHT

# Other settings

config ZMK_POINTING
    default y

# Assuming pointing device uses SPI
config SPI
    default y

endif
```
